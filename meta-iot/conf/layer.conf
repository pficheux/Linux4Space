## meta-iot/conf/layer.conf
```bitbake
# We have a conf and classes directory, add to BBPATH
BBPATH .= ":${LAYERDIR}"

# We have recipes-* directories, add to BBFILES
BBFILES += "${LAYERDIR}/recipes-*/*/*.bb \
            ${LAYERDIR}/recipes-*/*/*.bbappend"

BBFILE_COLLECTIONS += "meta-iot"
BBFILE_PATTERN_meta-iot = "^${LAYERDIR}/"
BBFILE_PRIORITY_meta-iot = "6"

LAYERDEPENDS_meta-iot = "core"
LAYERSERIES_COMPAT_meta-iot = "zeus dunfell"
```
